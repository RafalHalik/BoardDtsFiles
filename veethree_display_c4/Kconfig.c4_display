## veethree_display_c4/Kconfig.c4_display
```kconfig
#
# Copyright 2024 NXP
#
# SPDX-License-Identifier: Apache-2.0
#

config BOARD_C4_DISPLAY
	select SOC_PART_NUMBER_MIMXRT1166DVM6A
	select SOC_MIMXRT1166_CM7 if BOARD_C4_DISPLAY_MIMXRT1166_CM7
	select SOC_MIMXRT1166_CM4 if BOARD_C4_DISPLAY_MIMXRT1166_CM4
```
